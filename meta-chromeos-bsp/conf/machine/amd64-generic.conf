## meta-chromeos-bsp/conf/machine/amd64-generic.conf
```bitbake
#@TYPE: Machine
#@NAME: Generic x86_64
#@DESCRIPTION: Machine configuration for generic x86_64 (64-bit) PCs and servers. Supports a moderately wide range of drivers that should boot and be usable on "typical" hardware.

DEFAULTTUNE ?= "core2-64"
require conf/machine/include/x86/tune-core2.inc
require conf/machine/include/genericx86-common.inc

PREFERRED_PROVIDER_virtual/kernel = "linux-yocto-dev"
SERIAL_CONSOLES_CHECK = "ttyS0"
#For runqemu
QB_SYSTEM_NAME = "qemu-system-x86_64"

WKS_FILE = "qemu-amd64.wks"
# Without this, wic image generation might see:
#   WARNING: cannot expand variable EFI_PROVIDER
#   ERROR: unrecognized bootimg-efi loader: ${EFI_PROVIDER}
# TODO: figure out if this should be in the main poky WKS configuration, from
# which we derived our WKS_FILE?
WICVARS:append = "EFI_PROVIDER"
```

## meta-chromeos-bsp/wic/qemu-amd64.wks
```
# short-description: Create an EFI disk image for genericx86*
# long-description: Creates a partitioned EFI disk image for genericx86* machines
# borrowed from poky/meta-yocto-bsp/wic/genericx86.wks.in
part /boot --source bootimg-efi --sourceparams="loader=${EFI_PROVIDER}" --ondisk sda --label msdos --active --align 1024
part / --source rootfs --ondisk sda --fstype=ext4 --label platform --align 1024 --use-uuid
part swap --ondisk sda --size 44 --label swap1 --fstype=swap
part --ondisk sda --size 4G --label state --fstype=ext4

bootloader --ptable gpt --timeout=5 --append="rootfstype=ext4 console=ttyS0,115200 console=tty0"
```
